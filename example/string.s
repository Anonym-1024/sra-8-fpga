; generated by ylangc 0.4.1 (ABI 0.4, docs/ylangc.md)

        .import uart_getc
        .import uart_getc.frame
        .import uart_putc
        .import uart_putc.frame
        .export print
        .export print.frame
        .export println
        .export println.frame
        .export strlen
        .export strlen.frame
        .export strcmp
        .export strcmp.frame
        .export readstr
        .export readstr.frame

        .code

; ------------------------------------------------------------------------------
; strlen: fn([*]uint8) returns int8
; ------------------------------------------------------------------------------
        .addr   =strlen.frame          ; header: the frame of strlen ...
        .dword  6                      ; ... and its size
strlen:                                   ; leaf: r12a is never saved
; line 7: var len: int8 = 0;
        mov     r0, #0                 ; r0 = 0
        str     r0, =strlen.frame+5    ; len = r0
; line 8: loop {
strlen.2:                               ; loop
; line 9: if (str[len] eq 0) {
        ldr     r0, =strlen.frame+5    ; r0 = len
        mov     r1, #0                 ; sign extension of len: 0 ...
        andd    r0, #128               ; ... is the sign bit set?
        mov.ne  r1, #255               ; ... then 0xFF
        ldr     r10, =strlen.frame+1   ; r10a = str
        ldr     r11, =strlen.frame+2
        ldo     r2, r10a, r0a          ; r2 = str[len]
        cmp     r2, #0                 ; flags = str[len] - 0
        br.eq   =strlen.3              ; if str[len] eq 0
; line 10: break;
; line 12: len += 1;
        ldr     r0, =strlen.frame+5    ; r0 = len
        add     r0, r0, #1             ; len + 1
        str     r0, =strlen.frame+5    ; len = r0
        br      =strlen.2              ; again
strlen.3:                               ; end of loop
; line 14: return len;
        ldr     r0, =strlen.frame+5    ; r0 = len
        str     r0, =strlen.frame      ; result = r0
        br      r12a                   ; back to the caller

        .code

; ------------------------------------------------------------------------------
; strcmp: fn([*]uint8, [*]uint8) returns int8
; ------------------------------------------------------------------------------
        .addr   =strcmp.frame          ; header: the frame of strcmp ...
        .dword  8                      ; ... and its size
strcmp:                                   ; leaf: r12a is never saved
; line 18: var i: int8 = 0;
        mov     r0, #0                 ; r0 = 0
        str     r0, =strcmp.frame+7    ; i = r0
; line 19: loop {
strcmp.2:                               ; loop
; line 20: if (str1[i] eq 0 and str2[i] eq 0) {
        ldr     r0, =strcmp.frame+7    ; r0 = i
        mov     r1, #0                 ; sign extension of i: 0 ...
        andd    r0, #128               ; ... is the sign bit set?
        mov.ne  r1, #255               ; ... then 0xFF
        ldr     r10, =strcmp.frame+1   ; r10a = str1
        ldr     r11, =strcmp.frame+2
        ldo     r2, r10a, r0a          ; r2 = str1[i]
        cmp     r2, #0                 ; flags = str1[i] - 0
        br.ne   =strcmp.5              ; otherwise
        ldr     r0, =strcmp.frame+7    ; r0 = i
        mov     r1, #0                 ; sign extension of i: 0 ...
        andd    r0, #128               ; ... is the sign bit set?
        mov.ne  r1, #255               ; ... then 0xFF
        ldr     r10, =strcmp.frame+3   ; r10a = str2
        ldr     r11, =strcmp.frame+4
        ldo     r2, r10a, r0a          ; r2 = str2[i]
        cmp     r2, #0                 ; flags = str2[i] - 0
        br.ne   =strcmp.5              ; otherwise
; line 21: return 0;
        mov     r0, #0                 ; r0 = 0
        str     r0, =strcmp.frame      ; result = r0
        br      =strcmp.1              ; return
strcmp.5:                               ; not: (str1[i] eq 0) and (str2[i] eq 0)
; line 23: if (str1[i] ne str2[i]) {
        ldr     r0, =strcmp.frame+7    ; r0 = i
        mov     r1, #0                 ; sign extension of i: 0 ...
        andd    r0, #128               ; ... is the sign bit set?
        mov.ne  r1, #255               ; ... then 0xFF
        ldr     r10, =strcmp.frame+1   ; r10a = str1
        ldr     r11, =strcmp.frame+2
        ldo     r2, r10a, r0a          ; r2 = str1[i]
        ldr     r0, =strcmp.frame+7    ; r0 = i
        mov     r1, #0                 ; sign extension of i: 0 ...
        andd    r0, #128               ; ... is the sign bit set?
        mov.ne  r1, #255               ; ... then 0xFF
        ldr     r10, =strcmp.frame+3   ; r10a = str2
        ldr     r11, =strcmp.frame+4
        ldo     r3, r10a, r0a          ; r3 = str2[i]
        cmp     r2, r3                 ; flags = str1[i] - str2[i]
        br.eq   =strcmp.9              ; otherwise
; line 24: return @cast(int8 ,str1[i]) - @cast(int8, str2[i]);
        ldr     r0, =strcmp.frame+7    ; r0 = i
        mov     r1, #0                 ; sign extension of i: 0 ...
        andd    r0, #128               ; ... is the sign bit set?
        mov.ne  r1, #255               ; ... then 0xFF
        ldr     r10, =strcmp.frame+1   ; r10a = str1
        ldr     r11, =strcmp.frame+2
        ldo     r2, r10a, r0a          ; r2 = str1[i]
        ldr     r0, =strcmp.frame+7    ; r0 = i
        mov     r1, #0                 ; sign extension of i: 0 ...
        andd    r0, #128               ; ... is the sign bit set?
        mov.ne  r1, #255               ; ... then 0xFF
        ldr     r10, =strcmp.frame+3   ; r10a = str2
        ldr     r11, =strcmp.frame+4
        ldo     r3, r10a, r0a          ; r3 = str2[i]
        sub     r2, r2, r3             ; @cast(int8, str1[i]) - @cast(int8, st...
        str     r2, =strcmp.frame      ; result = r2
        br      =strcmp.1              ; return
strcmp.9:                               ; not: str1[i] ne str2[i]
; line 26: i += 1;
        ldr     r0, =strcmp.frame+7    ; r0 = i
        add     r0, r0, #1             ; i + 1
        str     r0, =strcmp.frame+7    ; i = r0
        br      =strcmp.2              ; again
; line 28: return 0;
strcmp.1:                               ; return
        br      r12a                   ; back to the caller

        .code

; ------------------------------------------------------------------------------
; print: fn([*]uint8)
; ------------------------------------------------------------------------------
        .addr   =print.frame           ; header: the frame of print ...
        .dword  5                      ; ... and its size
print:
        str     r12, =print.frame+2    ; save the return address
        str     r13, =print.frame+3
; line 32: var i: int8 = 0;
        mov     r0, #0                 ; r0 = 0
        str     r0, =print.frame+4     ; i = r0
; line 33: loop {
print.2:                                ; loop
; line 34: if (str[i] eq 0) {
        ldr     r0, =print.frame+4     ; r0 = i
        mov     r1, #0                 ; sign extension of i: 0 ...
        andd    r0, #128               ; ... is the sign bit set?
        mov.ne  r1, #255               ; ... then 0xFF
        ldr     r10, =print.frame      ; r10a = str
        ldr     r11, =print.frame+1
        ldo     r2, r10a, r0a          ; r2 = str[i]
        cmp     r2, #0                 ; flags = str[i] - 0
        br.eq   =print.1               ; if str[i] eq 0
; line 35: break;
; line 37: uart_putc(str[i]);
        ldr     r0, =print.frame+4     ; r0 = i
        mov     r1, #0                 ; sign extension of i: 0 ...
        andd    r0, #128               ; ... is the sign bit set?
        mov.ne  r1, #255               ; ... then 0xFF
        ldr     r10, =print.frame      ; r10a = str
        ldr     r11, =print.frame+1
        ldo     r2, r10a, r0a          ; r2 = str[i]
        str     r2, =uart_putc.frame   ; argument 1 of uart_putc = r2
        brl     r12a, =uart_putc       ; call uart_putc(str[i])
; line 38: i += 1;
        ldr     r0, =print.frame+4     ; r0 = i
        add     r0, r0, #1             ; i + 1
        str     r0, =print.frame+4     ; i = r0
        br      =print.2               ; again
; line 41: return;
print.1:                                ; return
        ldr     r12, =print.frame+2    ; reload the return address
        ldr     r13, =print.frame+3
        br      r12a                   ; back to the caller

        .code

; ------------------------------------------------------------------------------
; println: fn([*]uint8)
; ------------------------------------------------------------------------------
        .addr   =println.frame         ; header: the frame of println ...
        .dword  5                      ; ... and its size
println:
        str     r12, =println.frame+2  ; save the return address
        str     r13, =println.frame+3
; line 46: var i: int8 = 0;
        mov     r0, #0                 ; r0 = 0
        str     r0, =println.frame+4   ; i = r0
; line 47: loop {
println.2:                              ; loop
; line 48: if (str[i] eq 0) {
        ldr     r0, =println.frame+4   ; r0 = i
        mov     r1, #0                 ; sign extension of i: 0 ...
        andd    r0, #128               ; ... is the sign bit set?
        mov.ne  r1, #255               ; ... then 0xFF
        ldr     r10, =println.frame    ; r10a = str
        ldr     r11, =println.frame+1
        ldo     r2, r10a, r0a          ; r2 = str[i]
        cmp     r2, #0                 ; flags = str[i] - 0
        br.eq   =println.3             ; if str[i] eq 0
; line 49: break;
; line 51: uart_putc(str[i]);
        ldr     r0, =println.frame+4   ; r0 = i
        mov     r1, #0                 ; sign extension of i: 0 ...
        andd    r0, #128               ; ... is the sign bit set?
        mov.ne  r1, #255               ; ... then 0xFF
        ldr     r10, =println.frame    ; r10a = str
        ldr     r11, =println.frame+1
        ldo     r2, r10a, r0a          ; r2 = str[i]
        str     r2, =uart_putc.frame   ; argument 1 of uart_putc = r2
        brl     r12a, =uart_putc       ; call uart_putc(str[i])
; line 52: i += 1;
        ldr     r0, =println.frame+4   ; r0 = i
        add     r0, r0, #1             ; i + 1
        str     r0, =println.frame+4   ; i = r0
        br      =println.2             ; again
println.3:                              ; end of loop
; line 54: uart_putc('\n');
        mov     r0, #10                ; r0 = 10
        str     r0, =uart_putc.frame   ; argument 1 of uart_putc = r0
        brl     r12a, =uart_putc       ; call uart_putc(10)
; line 55: return;
        ldr     r12, =println.frame+2  ; reload the return address
        ldr     r13, =println.frame+3
        br      r12a                   ; back to the caller

        .code

; ------------------------------------------------------------------------------
; readstr: fn([*]uint8)
; ------------------------------------------------------------------------------
        .addr   =readstr.frame         ; header: the frame of readstr ...
        .dword  6                      ; ... and its size
readstr:
        str     r12, =readstr.frame+2  ; save the return address
        str     r13, =readstr.frame+3
; line 59: var c: char = 0;
        mov     r0, #0                 ; r0 = 0
        str     r0, =readstr.frame+4   ; c = r0
; line 60: var i: int8 = 0;
        mov     r0, #0                 ; r0 = 0
        str     r0, =readstr.frame+5   ; i = r0
; line 61: loop {
readstr.2:                              ; loop
; line 62: c = uart_getc();
        brl     r12a, =uart_getc       ; call uart_getc()
        ldr     r0, =uart_getc.frame   ; r0 = result of uart_getc
        str     r0, =readstr.frame+4   ; c = r0
; line 63: uart_putc(c);
        ldr     r0, =readstr.frame+4   ; r0 = c
        str     r0, =uart_putc.frame   ; argument 1 of uart_putc = r0
        brl     r12a, =uart_putc       ; call uart_putc(c)
; line 64: if (c eq '\n' or i gt 127) {
        ldr     r0, =readstr.frame+4   ; r0 = c
        cmp     r0, #10                ; flags = c - 10
        br.eq   =readstr.3             ; if c eq 10
        mov     r0, #127               ; r0 = 127
        ldr     r1, =readstr.frame+5   ; r1 = i
        cmp     r0, r1                 ; flags = 127 - i, byte 0
        br.ss   =readstr.3             ; if i gt 127
; line 65: break;
; line 67: str[i] = c;
        ldr     r0, =readstr.frame+4   ; r0 = c
        ldr     r1, =readstr.frame+5   ; r1 = i
        mov     r2, #0                 ; sign extension of i: 0 ...
        andd    r1, #128               ; ... is the sign bit set?
        mov.ne  r2, #255               ; ... then 0xFF
        ldr     r10, =readstr.frame    ; r10a = str
        ldr     r11, =readstr.frame+1
        sto     r0, r10a, r1a          ; str[i] = r0
; line 68: i += 1;
        ldr     r0, =readstr.frame+5   ; r0 = i
        add     r0, r0, #1             ; i + 1
        str     r0, =readstr.frame+5   ; i = r0
        br      =readstr.2             ; again
readstr.3:                              ; end of loop
; line 70: str[i] = 0;
        mov     r0, #0                 ; r0 = 0
        ldr     r1, =readstr.frame+5   ; r1 = i
        mov     r2, #0                 ; sign extension of i: 0 ...
        andd    r1, #128               ; ... is the sign bit set?
        mov.ne  r2, #255               ; ... then 0xFF
        ldr     r10, =readstr.frame    ; r10a = str
        ldr     r11, =readstr.frame+1
        sto     r0, r10a, r1a          ; str[i] = r0
; line 71: return;
        ldr     r12, =readstr.frame+2  ; reload the return address
        ldr     r13, =readstr.frame+3
        br      r12a                   ; back to the caller

        .bss

; frame of strlen, 6 bytes (ABI 0.4: the caller writes the arguments here)
;   +0    1   result
;   +1    2   str
;   +3    2   saved return address (r12a)
;   +5    1   len
strlen.frame:
        .res 6

; frame of strcmp, 8 bytes (ABI 0.4: the caller writes the arguments here)
;   +0    1   result
;   +1    2   str1
;   +3    2   str2
;   +5    2   saved return address (r12a)
;   +7    1   i
strcmp.frame:
        .res 8

; frame of print, 5 bytes (ABI 0.4: the caller writes the arguments here)
;   +0    2   str
;   +2    2   saved return address (r12a)
;   +4    1   i
print.frame:
        .res 5

; frame of println, 5 bytes (ABI 0.4: the caller writes the arguments here)
;   +0    2   str
;   +2    2   saved return address (r12a)
;   +4    1   i
println.frame:
        .res 5

; frame of readstr, 6 bytes (ABI 0.4: the caller writes the arguments here)
;   +0    2   str
;   +2    2   saved return address (r12a)
;   +4    1   c
;   +5    1   i
readstr.frame:
        .res 6
