; generated by ylangc 0.4.1 (ABI 0.4, docs/ylangc.md)

        .import println
        .import println.frame
        .import readstr
        .import readstr.frame
        .import strcmp
        .import strcmp.frame
        .import __stack_top
        .import __bss_start
        .import __bss_end
        .export str
        .export main
        .export main.frame

; start-up code at address 0: set the stack pointer, zero .bss, run the @main function, stop
        .code vector
        .export _start
_start: mova    r14a, =__stack_top     ; SP = the last byte of RAM; the stack grows down
        mova    r2a, =__bss_start      ; zero .bss (all files): r2a = the next byte ...
        mova    r4a, =__bss_end        ; ... up to r4a
        mov     r0, #0
.l zero:
        cmp     r2, r4                 ; r2a - r4a
        subcd   r3, r5
        br.geu  .f =zeroed             ; reached the end
        sti     r0, r2a, #1            ; zero a byte, r2a + 1
        br      .b =zero
.l zeroed:
        brl     r12a, =main               ; call main
.l spin:
        br      .b =spin               ; main returned: stop here

        .code

; ------------------------------------------------------------------------------
; echo: fn()
; ------------------------------------------------------------------------------
echo:
        str     r12, =echo.frame       ; save the return address
        str     r13, =echo.frame+1
; line 13: loop {
echo.2:                                 ; loop
; line 14: readstr(@ptr(str));
        mova    r10a, =str             ; r10a = @ptr(str)
        mov     r0, r10
        mov     r1, r11
        str     r0, =readstr.frame     ; argument 1 of readstr (byte 0) = r0
        str     r1, =readstr.frame+1   ; argument 1 of readstr (byte 1) = r1
        brl     r12a, =readstr         ; call readstr(@ptr(str))
; line 15: if (strcmp(@ptr(str), s"") eq 0) {
        mova    r10a, =str             ; r10a = @ptr(str)
        mov     r0, r10
        mov     r1, r11
        str     r0, =strcmp.frame+1    ; argument 1 of strcmp (byte 0) = r0
        str     r1, =strcmp.frame+2    ; argument 1 of strcmp (byte 1) = r1
        mova    r10a, =str.1           ; r10a = address of s""
        mov     r0, r10
        mov     r1, r11
        str     r0, =strcmp.frame+3    ; argument 2 of strcmp (byte 0) = r0
        str     r1, =strcmp.frame+4    ; argument 2 of strcmp (byte 1) = r1
        brl     r12a, =strcmp          ; call strcmp(@ptr(str), s"")
        ldr     r0, =strcmp.frame      ; r0 = result of strcmp
        cmp     r0, #0                 ; flags = strcmp(@ptr(str), s"") - 0
        br.eq   =echo.3                ; if strcmp(@ptr(str), s"") eq 0
; line 16: break;
; line 18: println(@ptr(str));
        mova    r10a, =str             ; r10a = @ptr(str)
        mov     r0, r10
        mov     r1, r11
        str     r0, =println.frame     ; argument 1 of println (byte 0) = r0
        str     r1, =println.frame+1   ; argument 1 of println (byte 1) = r1
        brl     r12a, =println         ; call println(@ptr(str))
        br      =echo.2                ; again
echo.3:                                 ; end of loop
        ldr     r12, =echo.frame       ; reload the return address
        ldr     r13, =echo.frame+1
        br      r12a                   ; back to the caller

        .code

; ------------------------------------------------------------------------------
; strtou16: fn([*]uint8) returns uint16
; ------------------------------------------------------------------------------
strtou16:                                   ; leaf: r12a is never saved
; line 27: var num: uint16 = 0;
        mov     r0, #0                 ; r0 = 0 (byte 0)
        mov     r1, #0                 ; r1 = 0 (byte 1)
        str     r0, =strtou16.frame+6  ; num (byte 0) = r0
        str     r1, =strtou16.frame+7  ; num (byte 1) = r1
; line 28: var i: uint8 = 0;
        mov     r0, #0                 ; r0 = 0
        str     r0, =strtou16.frame+8  ; i = r0
; line 29: loop {
strtou16.2:                             ; loop
; line 30: if (strin[i] eq 0) {
        ldr     r0, =strtou16.frame+8  ; r0 = i
        mov     r1, #0                 ; zero extension of i
        ldr     r10, =strtou16.frame+2 ; r10a = strin
        ldr     r11, =strtou16.frame+3
        ldo     r2, r10a, r0a          ; r2 = strin[i]
        cmp     r2, #0                 ; flags = strin[i] - 0
        br.eq   =strtou16.3            ; if strin[i] eq 0
; line 31: break;
; line 33: num = num * 10 + @cast(uint16, strin[i] - '0');
        ldr     r0, =strtou16.frame+6  ; r0 = num (byte 0)
        ldr     r1, =strtou16.frame+7  ; r1 = num (byte 1)
        lsls    r0, r0                 ; num * 2
        csl     r1, r1                 ; ... carry into byte 1
        mov     r2, r0                 ; num * 10: num * 2
        mov     r3, r1
        lsls    r0, r0                 ; num * 4
        csl     r1, r1                 ; ... carry into byte 1
        lsls    r0, r0                 ; num * 8
        csl     r1, r1                 ; ... carry into byte 1
        adds    r2, r2, r0             ; + num * 8, byte 0
        addc    r3, r3, r1             ; ... byte 1 with carry
        ldr     r0, =strtou16.frame+8  ; r0 = i
        mov     r1, #0                 ; zero extension of i
        ldr     r10, =strtou16.frame+2 ; r10a = strin
        ldr     r11, =strtou16.frame+3
        ldo     r4, r10a, r0a          ; r4 = strin[i]
        sub     r4, r4, #48            ; strin[i] - 48
        mov     r0, #0                 ; zero extension of strin[i] - 48
        adds    r2, r2, r4             ; (num * 10) + @cast(uint16, strin[i] -..., byte 0
        addc    r3, r3, r0             ; ... byte 1 with carry
        str     r2, =strtou16.frame+6  ; num (byte 0) = r2
        str     r3, =strtou16.frame+7  ; num (byte 1) = r3
; line 35: i += 1;
        ldr     r0, =strtou16.frame+8  ; r0 = i
        add     r0, r0, #1             ; i + 1
        str     r0, =strtou16.frame+8  ; i = r0
        br      =strtou16.2            ; again
strtou16.3:                             ; end of loop
; line 37: return num;
        ldr     r0, =strtou16.frame+6  ; r0 = num (byte 0)
        ldr     r1, =strtou16.frame+7  ; r1 = num (byte 1)
        str     r0, =strtou16.frame    ; result (byte 0) = r0
        str     r1, =strtou16.frame+1  ; result (byte 1) = r1
        br      r12a                   ; back to the caller

        .code

; ------------------------------------------------------------------------------
; u16tostr: fn(uint16, [*]uint8)
; ------------------------------------------------------------------------------
u16tostr:
        str     r12, =u16tostr.frame+4 ; save the return address
        str     r13, =u16tostr.frame+5
; line 42: var i: uint16 = 0;
        mov     r0, #0                 ; r0 = 0 (byte 0)
        mov     r1, #0                 ; r1 = 0 (byte 1)
        str     r0, =u16tostr.frame+6  ; i (byte 0) = r0
        str     r1, =u16tostr.frame+7  ; i (byte 1) = r1
; line 43: loop {
u16tostr.2:                             ; loop
; line 44: strout[i] = '0' + @cast(char, num % 10);
        ldr     r0, =u16tostr.frame    ; r0 = num (byte 0)
        ldr     r1, =u16tostr.frame+1  ; r1 = num (byte 1)
        str     r0, =__divmodu16.frame+2 ; a of __divmodu16 (byte 0) = r0
        str     r1, =__divmodu16.frame+3 ; a of __divmodu16 (byte 1) = r1
        mov     r0, #10                ; r0 = 10 (byte 0)
        mov     r1, #0                 ; r1 = 10 (byte 1)
        str     r0, =__divmodu16.frame+4 ; b of __divmodu16 (byte 0) = r0
        str     r1, =__divmodu16.frame+5 ; b of __divmodu16 (byte 1) = r1
        brl     r12a, =__divmodu16     ; call num % 10
        ldr     r0, =__divmodu16.frame+6 ; r0 = a % b of __divmodu16 (byte 0)
        ldr     r1, =__divmodu16.frame+7 ; r1 = a % b of __divmodu16 (byte 1)
        add     r0, r0, #48            ; 48 + @cast(uint8, num % 10)
        ldr     r1, =u16tostr.frame+6  ; r1 = i (byte 0)
        ldr     r2, =u16tostr.frame+7  ; r2 = i (byte 1)
        ldr     r10, =u16tostr.frame+2 ; r10a = strout
        ldr     r11, =u16tostr.frame+3
        sto     r0, r10a, r1a          ; strout[i] = r0
; line 45: num /= 10;
        ldr     r0, =u16tostr.frame    ; r0 = num (byte 0)
        ldr     r1, =u16tostr.frame+1  ; r1 = num (byte 1)
        str     r0, =__divmodu16.frame+2 ; a of __divmodu16 (byte 0) = r0
        str     r1, =__divmodu16.frame+3 ; a of __divmodu16 (byte 1) = r1
        mov     r0, #10                ; r0 = 10 (byte 0)
        mov     r1, #0                 ; r1 = 10 (byte 1)
        str     r0, =__divmodu16.frame+4 ; b of __divmodu16 (byte 0) = r0
        str     r1, =__divmodu16.frame+5 ; b of __divmodu16 (byte 1) = r1
        brl     r12a, =__divmodu16     ; call num / 10
        ldr     r0, =__divmodu16.frame ; r0 = a / b of __divmodu16 (byte 0)
        ldr     r1, =__divmodu16.frame+1 ; r1 = a / b of __divmodu16 (byte 1)
        str     r0, =u16tostr.frame    ; num (byte 0) = r0
        str     r1, =u16tostr.frame+1  ; num (byte 1) = r1
; line 46: i += 1;
        ldr     r0, =u16tostr.frame+6  ; r0 = i (byte 0)
        ldr     r1, =u16tostr.frame+7  ; r1 = i (byte 1)
        adds    r0, r0, #1             ; i + 1, byte 0
        addc    r1, r1, #0             ; ... byte 1 with carry
        str     r0, =u16tostr.frame+6  ; i (byte 0) = r0
        str     r1, =u16tostr.frame+7  ; i (byte 1) = r1
; line 47: if (num eq 0) {
        ldr     r0, =u16tostr.frame    ; r0 = num (byte 0)
        ldr     r1, =u16tostr.frame+1  ; r1 = num (byte 1)
        ord     r0, r1                 ; Z = all bytes equal
        br.ne   =u16tostr.2            ; otherwise
; line 49: break;
; line 52: strout[i] = 0;
        mov     r0, #0                 ; r0 = 0
        ldr     r1, =u16tostr.frame+6  ; r1 = i (byte 0)
        ldr     r2, =u16tostr.frame+7  ; r2 = i (byte 1)
        ldr     r10, =u16tostr.frame+2 ; r10a = strout
        ldr     r11, =u16tostr.frame+3
        sto     r0, r10a, r1a          ; strout[i] = r0
; line 55: var len: uint16 = i;
        ldr     r0, =u16tostr.frame+6  ; r0 = i (byte 0)
        ldr     r1, =u16tostr.frame+7  ; r1 = i (byte 1)
        str     r0, =u16tostr.frame+8  ; len (byte 0) = r0
        str     r1, =u16tostr.frame+9  ; len (byte 1) = r1
; line 56: var j: uint16 = 0;
        mov     r0, #0                 ; r0 = 0 (byte 0)
        mov     r1, #0                 ; r1 = 0 (byte 1)
        str     r0, =u16tostr.frame+10 ; j (byte 0) = r0
        str     r1, =u16tostr.frame+11 ; j (byte 1) = r1
; line 57: loop {
u16tostr.7:                             ; loop
; line 58: if (j eq len / 2) {
        ldr     r0, =u16tostr.frame+10 ; r0 = j (byte 0)
        ldr     r1, =u16tostr.frame+11 ; r1 = j (byte 1)
        ldr     r2, =u16tostr.frame+8  ; r2 = len (byte 0)
        ldr     r3, =u16tostr.frame+9  ; r3 = len (byte 1)
        lsrs    r3, r3                 ; len / 2: / 2
        csr     r2, r2                 ; ... carry into byte 0
        eor     r0, r0, r2             ; byte 0: 0 where j and len / 2 agree
        eor     r1, r1, r3             ; byte 1: 0 where j and len / 2 agree
        ord     r0, r1                 ; Z = all bytes equal
        br.eq   =u16tostr.8            ; if j eq (len / 2)
; line 59: break;
; line 61: var temp: char = strout[j];
        ldr     r0, =u16tostr.frame+10 ; r0 = j (byte 0)
        ldr     r1, =u16tostr.frame+11 ; r1 = j (byte 1)
        ldr     r10, =u16tostr.frame+2 ; r10a = strout
        ldr     r11, =u16tostr.frame+3
        ldo     r2, r10a, r0a          ; r2 = strout[j]
        str     r2, =u16tostr.frame+12 ; temp = r2
; line 62: strout[j] = strout[len - 1 - j];
        ldr     r0, =u16tostr.frame+8  ; r0 = len (byte 0)
        ldr     r1, =u16tostr.frame+9  ; r1 = len (byte 1)
        subs    r0, r0, #1             ; len - 1, byte 0
        subc    r1, r1, #0             ; ... byte 1 with borrow
        ldr     r2, =u16tostr.frame+10 ; r2 = j (byte 0)
        ldr     r3, =u16tostr.frame+11 ; r3 = j (byte 1)
        subs    r0, r0, r2             ; (len - 1) - j, byte 0
        subc    r1, r1, r3             ; ... byte 1 with borrow
        ldr     r10, =u16tostr.frame+2 ; r10a = strout
        ldr     r11, =u16tostr.frame+3
        ldo     r2, r10a, r0a          ; r2 = strout[(len - 1) - j]
        ldr     r0, =u16tostr.frame+10 ; r0 = j (byte 0)
        ldr     r1, =u16tostr.frame+11 ; r1 = j (byte 1)
        ldr     r10, =u16tostr.frame+2 ; r10a = strout
        ldr     r11, =u16tostr.frame+3
        sto     r2, r10a, r0a          ; strout[j] = r2
; line 63: strout[len - 1 - j] = temp;
        ldr     r0, =u16tostr.frame+12 ; r0 = temp
        ldr     r1, =u16tostr.frame+8  ; r1 = len (byte 0)
        ldr     r2, =u16tostr.frame+9  ; r2 = len (byte 1)
        subs    r1, r1, #1             ; len - 1, byte 0
        subc    r2, r2, #0             ; ... byte 1 with borrow
        ldr     r3, =u16tostr.frame+10 ; r3 = j (byte 0)
        ldr     r4, =u16tostr.frame+11 ; r4 = j (byte 1)
        subs    r1, r1, r3             ; (len - 1) - j, byte 0
        subc    r2, r2, r4             ; ... byte 1 with borrow
        ldr     r10, =u16tostr.frame+2 ; r10a = strout
        ldr     r11, =u16tostr.frame+3
        sto     r0, r10a, r1a          ; strout[(len - 1) - j] = r0
; line 64: j += 1;
        ldr     r0, =u16tostr.frame+10 ; r0 = j (byte 0)
        ldr     r1, =u16tostr.frame+11 ; r1 = j (byte 1)
        adds    r0, r0, #1             ; j + 1, byte 0
        addc    r1, r1, #0             ; ... byte 1 with carry
        str     r0, =u16tostr.frame+10 ; j (byte 0) = r0
        str     r1, =u16tostr.frame+11 ; j (byte 1) = r1
        br      =u16tostr.7            ; again
u16tostr.8:                             ; end of loop
        ldr     r12, =u16tostr.frame+4 ; reload the return address
        ldr     r13, =u16tostr.frame+5
        br      r12a                   ; back to the caller

        .code

; ------------------------------------------------------------------------------
; sum: fn()
; ------------------------------------------------------------------------------
sum:
        str     r12, =sum.frame        ; save the return address
        str     r13, =sum.frame+1
; line 70: var suma: uint16 = 0;
        mov     r0, #0                 ; r0 = 0 (byte 0)
        mov     r1, #0                 ; r1 = 0 (byte 1)
        str     r0, =sum.frame+2       ; suma (byte 0) = r0
        str     r1, =sum.frame+3       ; suma (byte 1) = r1
; line 71: loop {
sum.2:                                  ; loop
; line 72: readstr(@ptr(str));
        mova    r10a, =str             ; r10a = @ptr(str)
        mov     r0, r10
        mov     r1, r11
        str     r0, =readstr.frame     ; argument 1 of readstr (byte 0) = r0
        str     r1, =readstr.frame+1   ; argument 1 of readstr (byte 1) = r1
        brl     r12a, =readstr         ; call readstr(@ptr(str))
; line 73: if (strcmp(@ptr(str), s"") eq 0) {
        mova    r10a, =str             ; r10a = @ptr(str)
        mov     r0, r10
        mov     r1, r11
        str     r0, =strcmp.frame+1    ; argument 1 of strcmp (byte 0) = r0
        str     r1, =strcmp.frame+2    ; argument 1 of strcmp (byte 1) = r1
        mova    r10a, =str.2           ; r10a = address of s""
        mov     r0, r10
        mov     r1, r11
        str     r0, =strcmp.frame+3    ; argument 2 of strcmp (byte 0) = r0
        str     r1, =strcmp.frame+4    ; argument 2 of strcmp (byte 1) = r1
        brl     r12a, =strcmp          ; call strcmp(@ptr(str), s"")
        ldr     r0, =strcmp.frame      ; r0 = result of strcmp
        cmp     r0, #0                 ; flags = strcmp(@ptr(str), s"") - 0
        br.eq   =sum.3                 ; if strcmp(@ptr(str), s"") eq 0
; line 74: break;
; line 76: var num: uint16 = strtou16(@ptr(str));
        mova    r10a, =str             ; r10a = @ptr(str)
        mov     r0, r10
        mov     r1, r11
        str     r0, =strtou16.frame+2  ; argument 1 of strtou16 (byte 0) = r0
        str     r1, =strtou16.frame+3  ; argument 1 of strtou16 (byte 1) = r1
        brl     r12a, =strtou16        ; call strtou16(@ptr(str))
        ldr     r0, =strtou16.frame    ; r0 = result of strtou16 (byte 0)
        ldr     r1, =strtou16.frame+1  ; r1 = result of strtou16 (byte 1)
        str     r0, =sum.frame+4       ; num (byte 0) = r0
        str     r1, =sum.frame+5       ; num (byte 1) = r1
; line 77: suma += num;
        ldr     r0, =sum.frame+2       ; r0 = suma (byte 0)
        ldr     r1, =sum.frame+3       ; r1 = suma (byte 1)
        ldr     r2, =sum.frame+4       ; r2 = num (byte 0)
        ldr     r3, =sum.frame+5       ; r3 = num (byte 1)
        adds    r0, r0, r2             ; suma + num, byte 0
        addc    r1, r1, r3             ; ... byte 1 with carry
        str     r0, =sum.frame+2       ; suma (byte 0) = r0
        str     r1, =sum.frame+3       ; suma (byte 1) = r1
        br      =sum.2                 ; again
sum.3:                                  ; end of loop
; line 81: u16tostr(suma, @ptr(str));
        ldr     r0, =sum.frame+2       ; r0 = suma (byte 0)
        ldr     r1, =sum.frame+3       ; r1 = suma (byte 1)
        str     r0, =u16tostr.frame    ; argument 1 of u16tostr (byte 0) = r0
        str     r1, =u16tostr.frame+1  ; argument 1 of u16tostr (byte 1) = r1
        mova    r10a, =str             ; r10a = @ptr(str)
        mov     r0, r10
        mov     r1, r11
        str     r0, =u16tostr.frame+2  ; argument 2 of u16tostr (byte 0) = r0
        str     r1, =u16tostr.frame+3  ; argument 2 of u16tostr (byte 1) = r1
        brl     r12a, =u16tostr        ; call u16tostr(suma, @ptr(str))
; line 83: println(@ptr(str));
        mova    r10a, =str             ; r10a = @ptr(str)
        mov     r0, r10
        mov     r1, r11
        str     r0, =println.frame     ; argument 1 of println (byte 0) = r0
        str     r1, =println.frame+1   ; argument 1 of println (byte 1) = r1
        brl     r12a, =println         ; call println(@ptr(str))
        ldr     r12, =sum.frame        ; reload the return address
        ldr     r13, =sum.frame+1
        br      r12a                   ; back to the caller

        .code

; ------------------------------------------------------------------------------
; recognize_command: fn([*]uint8)
; ------------------------------------------------------------------------------
recognize_command:
        str     r12, =recognize_command.frame+2 ; save the return address
        str     r13, =recognize_command.frame+3
; line 89: if (strcmp(strin, s"echo") eq 0) {
        ldr     r0, =recognize_command.frame ; r0 = strin (byte 0)
        ldr     r1, =recognize_command.frame+1 ; r1 = strin (byte 1)
        str     r0, =strcmp.frame+1    ; argument 1 of strcmp (byte 0) = r0
        str     r1, =strcmp.frame+2    ; argument 1 of strcmp (byte 1) = r1
        mova    r10a, =str.3           ; r10a = address of s"echo"
        mov     r0, r10
        mov     r1, r11
        str     r0, =strcmp.frame+3    ; argument 2 of strcmp (byte 0) = r0
        str     r1, =strcmp.frame+4    ; argument 2 of strcmp (byte 1) = r1
        brl     r12a, =strcmp          ; call strcmp(strin, s"echo")
        ldr     r0, =strcmp.frame      ; r0 = result of strcmp
        cmp     r0, #0                 ; flags = strcmp(strin, s"echo") - 0
        br.ne   =recognize_command.3   ; otherwise
; line 90: echo();
        brl     r12a, =echo            ; call echo()
        br      =recognize_command.4   ; skip the else part
recognize_command.3:                    ; else
; line 91: } else if (strcmp(strin, s"sum") eq 0) {
        ldr     r0, =recognize_command.frame ; r0 = strin (byte 0)
        ldr     r1, =recognize_command.frame+1 ; r1 = strin (byte 1)
        str     r0, =strcmp.frame+1    ; argument 1 of strcmp (byte 0) = r0
        str     r1, =strcmp.frame+2    ; argument 1 of strcmp (byte 1) = r1
        mova    r10a, =str.4           ; r10a = address of s"sum"
        mov     r0, r10
        mov     r1, r11
        str     r0, =strcmp.frame+3    ; argument 2 of strcmp (byte 0) = r0
        str     r1, =strcmp.frame+4    ; argument 2 of strcmp (byte 1) = r1
        brl     r12a, =strcmp          ; call strcmp(strin, s"sum")
        ldr     r0, =strcmp.frame      ; r0 = result of strcmp
        cmp     r0, #0                 ; flags = strcmp(strin, s"sum") - 0
        br.ne   =recognize_command.6   ; otherwise
; line 92: sum();
        brl     r12a, =sum             ; call sum()
recognize_command.6:                    ; not: strcmp(strin, s"sum") eq 0
recognize_command.4:                    ; end of if
        ldr     r12, =recognize_command.frame+2 ; reload the return address
        ldr     r13, =recognize_command.frame+3
        br      r12a                   ; back to the caller

        .code

; ------------------------------------------------------------------------------
; main: fn()
; ------------------------------------------------------------------------------
        .addr   =main.frame            ; header: the frame of main ...
        .dword  2                      ; ... and its size
main:
        str     r12, =main.frame       ; save the return address
        str     r13, =main.frame+1
; line 101: loop {
main.2:                                 ; loop
; line 102: readstr(@ptr(str));
        mova    r10a, =str             ; r10a = @ptr(str)
        mov     r0, r10
        mov     r1, r11
        str     r0, =readstr.frame     ; argument 1 of readstr (byte 0) = r0
        str     r1, =readstr.frame+1   ; argument 1 of readstr (byte 1) = r1
        brl     r12a, =readstr         ; call readstr(@ptr(str))
; line 103: recognize_command(@ptr(str));
        mova    r10a, =str             ; r10a = @ptr(str)
        mov     r0, r10
        mov     r1, r11
        str     r0, =recognize_command.frame ; argument 1 of recognize_command (byte 0) = r0
        str     r1, =recognize_command.frame+1 ; argument 1 of recognize_command (byte 1) = r1
        brl     r12a, =recognize_command ; call recognize_command(@ptr(str))
        br      =main.2                ; again

        .code

; ------------------------------------------------------------------------------
; __divmodu16: a / b and a % b, unsigned, 16 bit (ylangc helper)
; ------------------------------------------------------------------------------
__divmodu16:
        ldr     r0, =__divmodu16.frame+2 ; a
        ldr     r1, =__divmodu16.frame+3
        ldr     r2, =__divmodu16.frame+4 ; b
        ldr     r3, =__divmodu16.frame+5
        mov     r4, #0                 ; remainder = 0
        mov     r5, #0
        mov     r6, #16                ; 16 passes, one per bit
__divmodu16.1:                          ; loop: shift a into the remainder, subtract b if it fits
        lsls    r0, r0                 ; remainder:a <<= 1, C = the bit out
        csls    r1, r1
        csls    r4, r4
        csls    r5, r5
        br.geu  =__divmodu16.2         ; a bit fell out: the remainder is > b
        cmp     r4, r2                 ; remainder - b
        subcd   r5, r3
        br.su   =__divmodu16.3         ; remainder < b: the quotient bit is 0
__divmodu16.2:
        subs    r4, r4, r2             ; remainder -= b
        subc    r5, r5, r3
        or      r0, r0, #1             ; the quotient bit is 1
__divmodu16.3:
        subs    r6, r6, #1             ; next pass
        br.ne   =__divmodu16.1
        str     r0, =__divmodu16.frame ; a / b
        str     r1, =__divmodu16.frame+1
        str     r4, =__divmodu16.frame+6 ; a % b
        str     r5, =__divmodu16.frame+7
        br      r12a                   ; back to the caller

        .data
str.1:
        .byte 0
str.2:
        .byte 0
str.3:
        .byte 101, 99, 104, 111, 0
str.4:
        .byte 115, 117, 109, 0

        .bss
str:
        .res 64

; frame of echo, 2 bytes (ABI 0.4: the caller writes the arguments here)
;   +0    2   saved return address (r12a)
echo.frame:
        .res 2

; frame of strtou16, 9 bytes (ABI 0.4: the caller writes the arguments here)
;   +0    2   result
;   +2    2   strin
;   +4    2   saved return address (r12a)
;   +6    2   num
;   +8    1   i
strtou16.frame:
        .res 9

; frame of u16tostr, 13 bytes (ABI 0.4: the caller writes the arguments here)
;   +0    2   num
;   +2    2   strout
;   +4    2   saved return address (r12a)
;   +6    2   i
;   +8    2   len
;   +10   2   j
;   +12   1   temp
u16tostr.frame:
        .res 13

; frame of sum, 6 bytes (ABI 0.4: the caller writes the arguments here)
;   +0    2   saved return address (r12a)
;   +2    2   suma
;   +4    2   num
sum.frame:
        .res 6

; frame of recognize_command, 4 bytes (ABI 0.4: the caller writes the arguments here)
;   +0    2   strin
;   +2    2   saved return address (r12a)
recognize_command.frame:
        .res 4

; frame of main, 2 bytes (ABI 0.4: the caller writes the arguments here)
;   +0    2   saved return address (r12a)
main.frame:
        .res 2

; frame of __divmodu16, 8 bytes (a ylangc helper)
;   +0    2   a / b
;   +2    2   a
;   +4    2   b
;   +6    2   a % b
__divmodu16.frame:
        .res 8
